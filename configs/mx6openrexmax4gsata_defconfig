## configs/mx6openrexmax4gsata_defconfig
```kconfig
CONFIG_SYS_EXTRA_OPTIONS="IMX_CONFIG=board/fedevel/mx6openrex/mx6openrexmax4g.cfg,MX6Q,DDR_SIZE=0xF0000000,ENV_IS_IN_SATA,MODULE_TYPE_PREFIX=\"imx6\",MODULE_TYPE_POSTFIX=\"max4g\""
CONFIG_ARM=y
CONFIG_TARGET_MX6OPENREX=y
CONFIG_DM=y
CONFIG_DM_THERMAL=y
```

## configs/mx6openrexultraandroid_defconfig
```kconfig
CONFIG_SYS_EXTRA_OPTIONS="IMX_CONFIG=board/fedevel/mx6openrex/mx6openrexultra.cfg,MX6QP,DDR_SIZE=0xF0000000,ENV_IS_IN_SPI_FLASH,MODULE_TYPE_PREFIX=\"imx6\",MODULE_TYPE_POSTFIX=\"ultra\",ANDROID_SUPPORT"
CONFIG_ARM=y
CONFIG_TARGET_MX6OPENREX=y
CONFIG_SYS_MALLOC_F=y
CONFIG_SYS_MALLOC_F_LEN=0x400
CONFIG_DM=y
CONFIG_DM_THERMAL=y
```

## configs/mx6openrexultrasata_defconfig
```kconfig
CONFIG_SYS_EXTRA_OPTIONS="IMX_CONFIG=board/fedevel/mx6openrex/mx6openrexultra.cfg,MX6QP,DDR_SIZE=0xF0000000,ENV_IS_IN_SATA,MODULE_TYPE_PREFIX=\"imx6\",MODULE_TYPE_POSTFIX=\"ultra\""
CONFIG_ARM=y
CONFIG_TARGET_MX6OPENREX=y
CONFIG_DM=y
CONFIG_DM_THERMAL=y
```

## configs/mx6rexultraandroid_defconfig
```kconfig
CONFIG_SYS_EXTRA_OPTIONS="IMX_CONFIG=board/fedevel/mx6rex/mx6rexultra.cfg,MX6QP,DDR_SIZE=0xF0000000,ENV_IS_IN_MMC,MODULE_TYPE_PREFIX=\"imx6\",MODULE_TYPE_POSTFIX=\"ultra\",ANDROID_SUPPORT"
CONFIG_ARM=y
CONFIG_TARGET_MX6REX=y
CONFIG_SYS_MALLOC_F=y
CONFIG_SYS_MALLOC_F_LEN=0x400
CONFIG_DM=y
CONFIG_DM_THERMAL=y
```

## configs/mx6tinyrexultra_defconfig
```kconfig
CONFIG_SYS_EXTRA_OPTIONS="IMX_CONFIG=board/fedevel/mx6tinyrex/mx6tinyrexultra.cfg,MX6Q,DDR_SIZE=0xF0000000,ENV_IS_IN_MMC,MODULE_TYPE_PREFIX=\"imx6\",MODULE_TYPE_POSTFIX=\"ultra\""
CONFIG_ARM=y
CONFIG_TARGET_MX6TINYREX=y
```
